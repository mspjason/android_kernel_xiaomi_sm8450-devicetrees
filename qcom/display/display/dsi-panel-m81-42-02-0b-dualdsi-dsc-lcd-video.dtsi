/* Reconstructed verbatim from liuqin OS3.0.7.0 stock DTBO. */

&mdss_mdp {
	dsi_m81_42_02_0b_dualdsi_dsc_lcd_video: qcom,mdss_dsi_m81_42_02_0b_dualdsi_dsc_lcd_video {
		qcom,dsi-select-clocks = "pll_byte_clk0", "pll_dsi_clk0";
		qcom,dsi-phy-num = <0x00 0x01>;
		qcom,dsi-ctrl-num = <0x00 0x01>;
		qcom,platform-reset-gpio = <&tlmm>, <0x00 0x00>;
		qcom,mdss-brightness-init-level = <0x133>;
		qcom,mdss-brightness-max-level = <0xfff>;
		qcom,mdss-dsi-bl-max-level = <0xfff>;
		qcom,mdss-dsi-bl-min-level = <0x02>;
		qcom,mdss-dsi-bl-pmic-control-type = "bl_ctrl_external";
		qcom,panel-supply-entries = <&dsi_panel_pwr_supply_M81>;
		mi,thermal-dimming-flag;
		mi,mdss-dsi-panel-max-luminance = <0x06 0x04>;
		mi,mdss-dsi-panel-xy-coordinate = <0x06 0x18>;
		mi,esd-err-irq-gpio-second = <&tlmm>, <0x74 0x2004>;
		mi,esd-err-irq-gpio = <&tlmm>, <0x14 0x2004>;
		mi,panel-on-dimming-delay = <0x12c>;
		mi,is-tddi-flag;
		mi,feature-enabled;
		mi,panel-id = <0x4d3831 0x50420200>;
		qcom,dsi-supported-dfps-list = <0x78 0x3c 0x90 0x5a 0x32 0x30 0x1e>;
		qcom,mdss-dsi-pan-fps-update = "dfps_immediate_porch_mode_vfp";
		qcom,mdss-dsi-pan-enable-dynamic-fps;
		qcom,mdss-dsi-panel-blackness-level = <0xc9e>;
		qcom,mdss-dsi-panel-peak-brightness = <0x401640>;
		qcom,mdss-dsi-panel-hdr-color-primaries = <0x38a4 0x3c8c 0x7d00 0x4268 0x3c8c 0x7530 0x1f40 0xbb8>;
		qcom,mdss-dsi-panel-hdr-enabled;
		qcom,mdss-dsi-clk-strength = <0xff>;
		qcom,mdss-dsi-phy-voltage = <0x51>;
		qcom,bl-update-flag = "delay_until_first_frame";
		qcom,mdss-dsi-panel-status-read-length = <0x01>;
		qcom,mdss-dsi-panel-status-value = <0x9d>;
		qcom,mdss-dsi-panel-status-command-state = "dsi_lp_mode";
		qcom,mdss-dsi-panel-status-command = <0x6010000 0x10a>;
		qcom,mdss-dsi-panel-status-check-mode = "irq_check";
		qcom,mdss-dsi-panel-broadcast-mode;
		qcom,cmd-sync-wait-broadcast;
		qcom,mdss-dsi-rx-eot-ignore;
		qcom,mdss-dsi-tx-eot-append;
		mi,mdss-fac-brightness-max-level = <0x7ff>;
		mi,mdss-dsi-fac-bl-max-level = <0x7ff>;
		qcom,mdss-pan-physical-height-dimension = <0x93f>;
		qcom,mdss-pan-physical-width-dimension = <0x5c8>;
		qcom,adjust-timer-wakeup-ms = <0x01>;
		qcom,mdss-dsi-reset-sequence = <0x00 0x0a 0x01 0x03 0x00 0x03 0x01 0x0f>;
		qcom,mdss-dsi-mdp-trigger = "none";
		qcom,mdss-dsi-dma-trigger = "trigger_sw";
		qcom,mdss-dsi-lane-3-state;
		qcom,mdss-dsi-lane-2-state;
		qcom,mdss-dsi-lane-1-state;
		qcom,mdss-dsi-lane-0-state;
		qcom,mdss-dsi-virtual-channel-id = <0x00>;
		qcom,mdss-dsi-lp11-init;
		qcom,mdss-dsi-bllp-power-mode;
		qcom,mdss-dsi-bllp-eof-power-mode;
		qcom,mdss-dsi-traffic-mode = "burst_mode";
		qcom,mdss-dsi-border-color = <0x00>;
		qcom,mdss-dsi-underflow-color = <0xff>;
		qcom,mdss-dsi-bpp = <0x18>;
		qcom,mdss-dsi-stream = <0x00>;
		qcom,mdss-dsi-panel-type = "dsi_video_mode";
		qcom,mdss-dsi-panel-name = "xiaomi m81 42 02 0b dualdsi dsc lcd video panel";

		qcom,mdss-dsi-display-timings {

			timing@0 {
				qcom,default-topology-index = <0x00>;
				qcom,display-topology = <0x02 0x02 0x02>;
				qcom,mdss-dsi-panel-phy-timings = [00 22 08 09 19 23 09 09 09 02 04 00 1c 0e];
				mi,mdss-dsi-insert-black-screen-command-state = "dsi_lp_mode";
				mi,mdss-dsi-insert-black-screen-command = [15 00 00 00 00 00 02 ff 10 39 00 00 00 00 00 02 22 00];
				mi,mdss-dsi-disable-insert-black-command-state = "dsi_lp_mode";
				mi,mdss-dsi-disable-insert-black-command = [15 00 00 00 00 00 02 ff 10 39 00 00 00 00 00 02 13 00];
				mi,mdss-dsi-max-luminance-read-command-state = "dsi_lp_mode";
				mi,mdss-dsi-max-luminance-read-command = <0x6000000 0x1a1>;
				mi,mdss-dsi-max-luminance-write-command-state = "dsi_lp_mode";
				mi,mdss-dsi-max-luminance-write-command = [15 00 00 00 00 00 02 ff 10];
				mi,mdss-dsi-xy-coordinate-command-state = "dsi_lp_mode";
				mi,mdss-dsi-xy-coordinate-command = [15 00 00 00 00 00 02 ff 10 06 00 00 00 00 00 01 a1];
				mi,mdss-dsi-dimmingon-command-state = "dsi_lp_mode";
				mi,mdss-dsi-cabcoff-command-state = "dsi_lp_mode";
				mi,mdss-dsi-cabcmovieon-command-state = "dsi_lp_mode";
				mi,mdss-dsi-cabcstillon-command-state = "dsi_lp_mode";
				mi,mdss-dsi-cabcuion-command-state = "dsi_lp_mode";
				mi,mdss-dsi-dimmingon-command = <0x39000040 0x2ff 0x27390000 0x02 0xd1281500 0x00 0x2ff1015 0x00 0x2532c>;
				mi,mdss-dsi-cabcoff-command = [15 00 00 00 00 00 02 ff 10 15 00 00 00 00 00 02 55 00];
				mi,mdss-dsi-cabcmovieon-command = [15 00 00 00 00 00 02 ff 10 15 00 00 00 00 00 02 55 03];
				mi,mdss-dsi-cabcstillon-command = [15 00 00 00 00 00 02 ff 10 15 00 00 00 00 00 02 55 02];
				mi,mdss-dsi-cabcuion-command = [15 00 00 00 00 00 02 ff 10 15 00 00 00 00 00 02 55 01];
				mi,mdss-dsi-dispparam-pen-clear-command-state = "dsi_lp_mode";
				qcom,mdss-dsi-dispparam-pen-48hz-command-state = "dsi_lp_mode";
				qcom,mdss-dsi-dispparam-pen-90hz-command-state = "dsi_lp_mode";
				qcom,mdss-dsi-dispparam-pen-144hz-command-state = "dsi_lp_mode";
				qcom,mdss-dsi-dispparam-pen-30hz-command-state = "dsi_lp_mode";
				qcom,mdss-dsi-dispparam-pen-60hz-command-state = "dsi_lp_mode";
				qcom,mdss-dsi-dispparam-pen-120hz-command-state = "dsi_lp_mode";
				mi,mdss-dsi-dispparam-pen-clear-command = [39 00 00 40 00 00 02 ff 10 39 00 00 40 00 00 02 fb 01 39 00 00 00 00 00 02 b2 80];
				qcom,mdss-dsi-dispparam-pen-90hz-command = [39 00 00 40 00 00 02 ff 10 39 00 00 40 00 00 02 b3 80 39 00 00 00 00 00 02 b2 00];
				qcom,mdss-dsi-dispparam-pen-30hz-command = [39 00 00 40 00 00 02 ff 10 39 00 00 40 00 00 02 b3 80 39 00 00 00 00 00 02 b2 00];
				qcom,mdss-dsi-dispparam-pen-60hz-command = [39 00 00 40 00 00 02 ff 10 39 00 00 40 00 00 02 b3 40 39 00 00 00 00 00 02 b2 91];
				qcom,mdss-dsi-dispparam-pen-120hz-command = [39 00 00 40 00 00 02 ff 10 39 00 00 40 00 00 02 b3 40 39 00 00 00 00 00 02 b2 91];
				qcom,mdss-dsi-dispparam-pen-48hz-command = [39 00 00 40 00 00 02 ff 10 39 00 00 40 00 00 02 b3 80 39 00 00 00 00 00 02 b2 00];
				qcom,mdss-dsi-dispparam-pen-144hz-command = [39 00 00 40 00 00 02 ff 10 39 00 00 40 00 00 02 b3 00 39 00 00 00 00 00 02 b2 00];
				qcom,mdss-dsc-block-prediction-enable;
				qcom,mdss-dsc-bit-per-pixel = <0x08>;
				qcom,mdss-dsc-bit-per-component = <0x08>;
				qcom,mdss-dsc-slice-per-pkt = <0x02>;
				qcom,mdss-dsc-slice-width = <0x1c2>;
				qcom,mdss-dsc-slice-height = <0x14>;
				qcom,mdss-dsc-scr-version = <0x00>;
				qcom,mdss-dsc-version = <0x11>;
				qcom,compression-mode = "dsc";
				qcom,mdss-dsi-off-command-state = "dsi_lp_mode";
				qcom,mdss-dsi-on-command-state = "dsi_lp_mode";
				qcom,mdss-dsi-off-command = [39 00 00 40 00 00 02 ff 27 39 00 00 00 00 00 02 d1 20 39 00 00 40 00 00 02 ff 10 39 00 00 00 00 00 02 28 00 39 00 00 00 78 00 02 10 00];
				qcom,mdss-dsi-on-command = [39 00 00 40 00 00 02 ff 27 39 00 00 40 00 00 02 fb 01 39 00 00 40 00 00 02 d0 31 39 00 00 40 00 00 02 d1 20 39 00 00 40 00 00 02 d2 38 39 00 00 40 00 00 02 de 43 39 00 00 00 00 00 02 df 02 39 00 00 40 00 00 02 ff 23 39 00 00 40 00 00 02 fb 01 39 00 00 40 00 00 02 00 80 39 00 00 40 00 00 02 01 84 39 00 00 40 00 00 02 05 2d 39 00 00 40 00 00 02 06 00 39 00 00 40 00 00 02 11 03 39 00 00 40 00 00 02 12 2a 39 00 00 40 00 00 02 15 d0 39 00 00 40 00 00 02 16 16 39 00 00 40 00 00 02 29 0a 39 00 00 40 00 00 02 30 ff 39 00 00 40 00 00 02 31 fe 39 00 00 40 00 00 02 32 fd 39 00 00 40 00 00 02 33 fb 39 00 00 40 00 00 02 34 f8 39 00 00 40 00 00 02 35 f5 39 00 00 40 00 00 02 36 f3 39 00 00 40 00 00 02 37 f2 39 00 00 40 00 00 02 38 f2 39 00 00 40 00 00 02 39 f2 39 00 00 40 00 00 02 3a ef 39 00 00 40 00 00 02 3b ec 39 00 00 40 00 00 02 3d e9 39 00 00 40 00 00 02 3f e5 39 00 00 40 00 00 02 40 e5 39 00 00 40 00 00 02 41 e5 39 00 00 40 00 00 02 2a 13 39 00 00 40 00 00 02 45 ff 39 00 00 40 00 00 02 46 f4 39 00 00 40 00 00 02 47 e7 39 00 00 40 00 00 02 48 da 39 00 00 40 00 00 02 49 cd 39 00 00 40 00 00 02 4a c0 39 00 00 40 00 00 02 4b b3 39 00 00 40 00 00 02 4c b1 39 00 00 40 00 00 02 4d b1 39 00 00 40 00 00 02 4e b1 39 00 00 40 00 00 02 4f 95 39 00 00 40 00 00 02 50 79 39 00 00 40 00 00 02 51 5c 39 00 00 40 00 00 02 52 58 39 00 00 40 00 00 02 53 58 39 00 00 40 00 00 02 54 58 39 00 00 40 00 00 02 2b 0e 39 00 00 40 00 00 02 58 ff 39 00 00 40 00 00 02 59 fb 39 00 00 40 00 00 02 5a f7 39 00 00 40 00 00 02 5b f3 39 00 00 40 00 00 02 5c ef 39 00 00 40 00 00 02 5d e3 39 00 00 40 00 00 02 5e d8 39 00 00 40 00 00 02 5f d6 39 00 00 40 00 00 02 60 d6 39 00 00 40 00 00 02 61 d6 39 00 00 40 00 00 02 62 c8 39 00 00 40 00 00 02 63 b7 39 00 00 40 00 00 02 64 aa 39 00 00 40 00 00 02 65 a8 39 00 00 40 00 00 02 66 a8 39 00 00 00 00 00 02 67 a8 39 00 00 40 00 00 02 ff 20 39 00 00 40 00 00 02 fb 01 39 00 00 40 00 00 02 65 cc 39 00 00 40 00 00 02 6d cc 39 00 00 40 00 00 02 32 72 39 00 00 00 00 00 02 17 11 39 00 00 40 00 00 02 ff 22 39 00 00 40 00 00 02 fb 01 39 00 00 40 00 00 02 9f 57 39 00 00 40 00 00 05 b0 1f 1f 1f 1f 39 00 00 40 00 00 05 b1 4d 4d 4d 4d 39 00 00 40 00 00 05 b2 1e 1e 1e 1e 39 00 00 40 00 00 05 b3 6c 6c 6c 6c 39 00 00 40 00 00 05 b4 1f 1f 1f 1f 39 00 00 40 00 00 05 b5 44 44 44 44 39 00 00 40 00 00 02 b8 00 39 00 00 40 00 00 02 b9 6e 39 00 00 40 00 00 02 ba 6e 39 00 00 40 00 00 02 bb 6e 39 00 00 40 00 00 02 be 0b 39 00 00 40 00 00 02 bf 6e 39 00 00 40 00 00 02 f8 cc 39 00 00 40 00 00 02 f9 cc 39 00 00 40 00 00 02 c1 6e 39 00 00 00 00 00 02 c3 6e 39 00 00 40 00 00 02 ff 23 39 00 00 40 00 00 02 fb 01 39 00 00 40 00 00 03 ba 7a 5d 39 00 00 00 00 00 03 bb 77 60 39 00 00 40 00 00 02 ff 24 39 00 00 40 00 00 02 fb 01 39 00 00 40 00 00 02 1c 80 39 00 00 40 00 00 04 92 45 00 c0 39 00 00 00 00 00 02 db 33 39 00 00 40 00 00 02 ff 25 39 00 00 40 00 00 02 fb 01 39 00 00 40 00 00 02 05 00 39 00 00 40 00 00 02 23 09 39 00 00 40 00 00 02 24 16 39 00 00 40 00 00 02 2a 09 39 00 00 40 00 00 02 2b 16 39 00 00 40 00 00 02 42 0b 39 00 00 40 00 00 02 c5 1e 39 00 00 40 00 00 02 f6 02 39 00 00 00 00 00 02 f7 48 39 00 00 40 00 00 02 ff 26 39 00 00 40 00 00 02 fb 01 39 00 00 40 00 00 02 04 75 39 00 00 40 00 00 05 19 10 12 12 12 39 00 00 40 00 00 05 1a c5 a3 a3 a3 39 00 00 40 00 00 05 1b 0f 11 11 11 39 00 00 40 00 00 05 1c e8 c6 c6 c6 39 00 00 40 00 00 02 1e 45 39 00 00 40 00 00 02 1f 45 39 00 00 40 00 00 05 2a 10 12 12 12 39 00 00 40 00 00 05 2b c0 9e 9e 9e 39 00 00 40 00 00 02 2f 0b 39 00 00 40 00 00 02 30 45 39 00 00 40 00 00 02 32 45 39 00 00 40 00 00 02 33 22 39 00 00 40 00 00 02 34 92 39 00 00 40 00 00 02 35 78 39 00 00 40 00 00 02 36 96 39 00 00 40 00 00 02 37 78 39 00 00 40 00 00 02 38 06 39 00 00 40 00 00 02 3a 45 39 00 00 40 00 00 02 40 47 39 00 00 40 00 00 02 41 47 39 00 00 40 00 00 02 42 47 39 00 00 40 00 00 02 45 0b 39 00 00 40 00 00 02 46 47 39 00 00 40 00 00 02 48 47 39 00 00 40 00 00 02 4a 47 39 00 00 40 00 00 02 80 cc 39 00 00 40 00 00 02 81 cc 39 00 00 40 00 00 04 84 16 16 16 39 00 00 40 00 00 04 85 26 26 26 39 00 00 40 00 00 02 8b aa 39 00 00 40 00 00 05 99 26 26 26 26 39 00 00 40 00 00 05 9a b6 b6 b6 b6 39 00 00 40 00 00 05 9b 25 25 25 25 39 00 00 40 00 00 05 9c d4 d4 d4 d4 39 00 00 40 00 00 05 9d 26 26 26 26 39 00 00 00 00 00 05 9e ac ac ac ac 39 00 00 40 00 00 02 ff 27 39 00 00 40 00 00 02 fb 01 39 00 00 40 00 00 02 01 c1 39 00 00 40 00 00 02 07 01 39 00 00 40 00 00 03 08 3c 0d 39 00 00 40 00 00 03 0a eb 40 39 00 00 40 00 00 03 0c 4b 00 39 00 00 40 00 00 03 0e eb 40 39 00 00 40 00 00 03 10 4b 00 39 00 00 40 00 00 02 14 33 39 00 00 40 00 00 02 76 f0 39 00 00 40 00 00 02 77 02 39 00 00 40 00 00 02 79 29 39 00 00 40 00 00 02 7e 4e 39 00 00 40 00 00 03 80 c9 0c 39 00 00 40 00 00 03 81 3d 00 39 00 00 40 00 00 03 82 cb c0 39 00 00 40 00 00 03 84 92 00 39 00 00 40 00 00 03 85 36 00 39 00 00 40 00 00 03 86 cb c0 39 00 00 00 00 00 03 88 92 00 39 00 00 40 00 00 02 ff 2a 39 00 00 40 00 00 02 fb 01 39 00 00 40 00 00 02 14 09 39 00 00 40 00 00 02 1e 09 39 00 00 40 00 00 02 1f 09 39 00 00 40 00 00 02 a3 00 39 00 00 40 00 00 02 c5 09 39 00 00 00 00 00 02 c6 16 39 00 00 40 00 00 02 ff 10 39 00 00 40 00 00 02 fb 01 39 00 00 40 00 00 02 b3 40 39 00 00 40 00 00 02 b2 91 39 00 00 40 00 00 02 90 03 39 00 00 40 00 00 11 91 89 28 00 14 d2 00 01 f4 01 ab 00 06 05 7a 06 1a 39 00 00 40 00 00 03 92 10 f0 39 00 00 40 00 00 07 3b 03 d8 1a 0a 0a 00 39 00 00 40 00 00 03 51 0f ff 39 00 00 40 00 00 02 53 24 39 00 00 00 00 00 02 35 00 39 00 00 00 78 00 02 11 00 39 00 00 00 14 00 02 29 00];
				qcom,mdss-dsi-panel-clockrate = <0x3c061800>;
				qcom,mdss-dsi-v-bottom-border = <0x00>;
				qcom,mdss-dsi-v-top-border = <0x00>;
				qcom,mdss-dsi-h-right-border = <0x00>;
				qcom,mdss-dsi-h-left-border = <0x00>;
				qcom,mdss-dsi-v-front-porch = <0x1a>;
				qcom,mdss-dsi-v-back-porch = <0xd6>;
				qcom,mdss-dsi-v-pulse-width = <0x02>;
				qcom,mdss-dsi-h-sync-skew = <0x00>;
				qcom,mdss-dsi-h-front-porch = <0x64>;
				qcom,mdss-dsi-h-back-porch = <0x2e>;
				qcom,mdss-dsi-h-pulse-width = <0x02>;
				qcom,mdss-dsi-panel-height = <0xb40>;
				qcom,mdss-dsi-panel-width = <0x384>;
				qcom,mdss-dsi-panel-framerate = <0x78>;
			};
		};
	};
};
